## sdkconfig.defaults
```kconfig
CONFIG_IDF_TARGET="esp32c6"

# Flash configuration
CONFIG_ESPTOOLPY_FLASHSIZE_8MB=y

# Partition table configuration
CONFIG_PARTITION_TABLE_CUSTOM=y
CONFIG_PARTITION_TABLE_CUSTOM_FILENAME="partitions.csv"

# LVGL configuration
CONFIG_LV_COLOR_16_SWAP=y
CONFIG_LV_FONT_MONTSERRAT_12=y
CONFIG_LV_FONT_MONTSERRAT_16=y
CONFIG_LV_FONT_MONTSERRAT_20=y
CONFIG_LV_USE_DEMO_WIDGETS=y
CONFIG_LV_USE_DEMO_BENCHMARK=y
CONFIG_LV_USE_DEMO_STRESS=y
CONFIG_LV_USE_DEMO_MUSIC=y

## LVGL8 ##
CONFIG_LV_MEM_SIZE_KILOBYTES=48
```
